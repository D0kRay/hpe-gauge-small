## main/Kconfig.projbuild
```kconfig
menu "HPE Gauge BSP"

config HPE_LCD_HOST
    int "SPI host number for GC9A01"
    default 2
    range 1 3

config HPE_PIN_LCD_MOSI
    int "LCD MOSI GPIO"
    default 10

config HPE_PIN_LCD_SCLK
    int "LCD SCLK GPIO"
    default 3

config HPE_PIN_LCD_CS
    int "LCD CS GPIO"
    default 2

config HPE_PIN_LCD_DC
    int "LCD D/C GPIO"
    default 18

config HPE_PIN_LCD_RST
    int "LCD reset GPIO"
    default 21

config HPE_PIN_LCD_BL
    int "LCD backlight GPIO"
    default 42

config HPE_PIN_TOUCH_SDA
    int "Touch/IMU/RTC I2C SDA GPIO"
    default 8

config HPE_PIN_TOUCH_SCL
    int "Touch/IMU/RTC I2C SCL GPIO"
    default 9

config HPE_PIN_TOUCH_INT
    int "Touch INT GPIO"
    default 11

config HPE_PIN_TOUCH_RST
    int "Touch reset GPIO"
    default 0

config HPE_PIN_TWAI_TX
    int "TWAI TX GPIO"
    default 43

config HPE_PIN_TWAI_RX
    int "TWAI RX GPIO"
    default 44

config HPE_TWAI_BITRATE
    int "TWAI bitrate"
    default 500000

config HPE_CAN_CFG_PATH
    string "CAN mapping config file path"
    default "/littlefs/can_messages.cfg"

menu "UI"

config HPE_UI_SPEED_MAX
    int "Speed gauge max"
    default 240

config HPE_UI_RPM_MAX
    int "RPM gauge max"
    default 9000

config HPE_LVGL_TICK_MS
    int "LVGL tick period (ms)"
    default 2

endmenu

menu "Web UI"

config HPE_WIFI_AP_SSID
    string "WiFi AP SSID"
    default "hpe-gauge"

config HPE_WIFI_AP_PASS
    string "WiFi AP password (min 8 chars for WPA2, shorter => open AP)"
    default "hpe-gauge"

config HPE_WIFI_AP_CHANNEL
    int "WiFi AP channel"
    default 1
    range 1 13

config HPE_WIFI_MAX_CONN
    int "Max WiFi/WebSocket clients"
    default 4
    range 1 8

config HPE_WEB_WS_PERIOD_MS
    int "WebSocket telemetry period (ms)"
    default 500
    range 100 5000

config HPE_WEB_OTA_REBOOT_DELAY_MS
    int "Delay before reboot after accepted OTA (ms)"
    default 2000
    range 250 10000

endmenu

menu "LVGL"

config LV_USE_ARC
    bool "Enable LVGL arc widget"
    default y

config LV_USE_MENU
    bool "Enable LVGL menu widget"
    default y

config LV_USE_TABVIEW
    bool "Enable LVGL tabview widget"
    default y

config LV_USE_LABEL
    bool "Enable LVGL label widget"
    default y

config LV_USE_BUTTON
    bool "Enable LVGL button widget"
    default y

# Keep all built-in LVGL fonts enabled for this project.
config LV_FONT_MONTSERRAT_8
    default y

config LV_FONT_MONTSERRAT_10
    default y

config LV_FONT_MONTSERRAT_12
    default y

config LV_FONT_MONTSERRAT_14
    default y

config LV_FONT_MONTSERRAT_16
    default y

config LV_FONT_MONTSERRAT_18
    default y

config LV_FONT_MONTSERRAT_20
    default y

config LV_FONT_MONTSERRAT_22
    default y

config LV_FONT_MONTSERRAT_24
    default y

config LV_FONT_MONTSERRAT_26
    default y

config LV_FONT_MONTSERRAT_28
    default y

config LV_FONT_MONTSERRAT_30
    default y

config LV_FONT_MONTSERRAT_32
    default y

config LV_FONT_MONTSERRAT_34
    default y

config LV_FONT_MONTSERRAT_36
    default y

config LV_FONT_MONTSERRAT_38
    default y

config LV_FONT_MONTSERRAT_40
    default y

config LV_FONT_MONTSERRAT_42
    default y

config LV_FONT_MONTSERRAT_44
    default y

config LV_FONT_MONTSERRAT_46
    default y

config LV_FONT_MONTSERRAT_48
    default y

config LV_FONT_MONTSERRAT_28_COMPRESSED
    default y

config LV_FONT_DEJAVU_16_PERSIAN_HEBREW
    default y

config LV_FONT_SOURCE_HAN_SANS_SC_14_CJK
    default y

config LV_FONT_SOURCE_HAN_SANS_SC_16_CJK
    default y

config LV_FONT_UNSCII_8
    default y

config LV_FONT_UNSCII_16
    default y

config LV_FONT_FMT_TXT_LARGE
    default y

config LV_USE_FONT_COMPRESSED
    default y

endmenu

endmenu
```

## sdkconfig.defaults
```kconfig
CONFIG_IDF_TARGET="esp32s3"
CONFIG_PARTITION_TABLE_CUSTOM=y
CONFIG_PARTITION_TABLE_CUSTOM_FILENAME="partitions.csv"
CONFIG_PARTITION_TABLE_FILENAME="partitions.csv"
CONFIG_ESP_CONSOLE_USB_SERIAL_JTAG=y
CONFIG_ESP_CONSOLE_UART_NONE=y
CONFIG_ESPTOOLPY_FLASHMODE_DIO=y
CONFIG_ESPTOOLPY_FLASHFREQ_40M=y
CONFIG_ESPTOOLPY_FLASHSIZE_16MB=y
CONFIG_LV_CONF_SKIP=y
CONFIG_FREERTOS_HZ=1000
CONFIG_COMPILER_OPTIMIZATION_SIZE=y
CONFIG_HTTPD_WS_SUPPORT=y
CONFIG_HPE_PIN_LCD_MOSI=10
CONFIG_HPE_PIN_LCD_SCLK=3
CONFIG_HPE_PIN_LCD_CS=2
CONFIG_HPE_PIN_LCD_DC=18
CONFIG_HPE_PIN_LCD_RST=21
CONFIG_HPE_PIN_LCD_BL=42
CONFIG_HPE_PIN_TOUCH_SDA=8
CONFIG_HPE_PIN_TOUCH_SCL=9
CONFIG_HPE_PIN_TOUCH_INT=11
CONFIG_HPE_PIN_TOUCH_RST=0
CONFIG_HPE_PIN_TWAI_TX=43
CONFIG_HPE_PIN_TWAI_RX=44
```
